## opensource/kernel-4.4.94/drivers/mtd/devices/ingenic_sfc_v2/Kconfig
```kconfig
config INGENIC_SFC_V2
	tristate "Ingenic series SFC driver v2"
	depends on MACH_XBURST || MACH_XBURST2
	help
		SFC driver version v2.0 for Ingenic series SoCs

if INGENIC_SFC_V2

config MTD_INGENIC_SFC_V2_NORFLASH
	bool "Support ingenic sfc-nor"
	depends on INGENIC_SFC_V2

if MTD_INGENIC_SFC_V2_NORFLASH
choice
	prompt "Erase block size"
	help
	  Select nor flash erase block size

config ERASE_SIZE_32K
	bool "sfc-nor 32k erase block"
	depends on MTD_INGENIC_SFC_V2_NORFLASH

config ERASE_SIZE_64K
	bool "sfc-nor 64k erase block"
	depends on MTD_INGENIC_SFC_V2_NORFLASH

endchoice

config JZ_SFC_NOR_RESET
	bool "Reset nor flash in the kernel"
	depends on MTD_INGENIC_SFC_V2_NORFLASH
	help
		Reset nor flash in the kernel
endif

config MTD_INGENIC_SFC_V2_NANDFLASH
	bool "Support ingenic sfc-nand"
	depends on INGENIC_SFC_V2
	select MTD_NAND

choice
	prompt "sfc Mode"
	help
	  Select sfc Mode

config SPI_STANDARD_MODE
	bool "standard spi mode"
	depends on INGENIC_SFC_V2
	help
	  Say Y here to enable spi standard mode

config SPI_QUAD_MODE
	bool "quad spi mode"
	depends on INGENIC_SFC_V2
	help
	  Say Y Here to enable spi QUAD MODE
endchoice

endif
```

## opensource/kernel-4.4.94/drivers/net/wireless/bcmdhd.100.10.545.x/Kconfig
```kconfig
config BCMDHD_100_10_545_X
	tristate "Broadcom FullMAC wireless cards support ver:100.10.545.x"
	---help---
	  This module adds support for wireless adapters based on
	  Broadcom FullMAC chipset.

config BCMDHD_100_10_545_X_FW_PATH
	depends on BCMDHD_100_10_545_X
	string "Firmware path"
	default "/system/etc/firmware/fw_bcmdhd.bin"
	---help---
	  Path to the firmware file.

config BCMDHD_100_10_545_X_NVRAM_PATH
	depends on BCMDHD_100_10_545_X
	string "NVRAM path"
	default "/system/etc/firmware/nvram.txt"
	---help---
	  Path to the calibration file.

config BCMDHD_100_10_545_X_WEXT
	bool "Enable WEXT support"
	depends on BCMDHD_100_10_545_X && CFG80211 = n
	select WIRELESS_EXT
	select WEXT_PRIV
	help
	  Enables WEXT support

choice
	prompt "Enable Chip Interface"
	depends on BCMDHD_100_10_545_X
	---help---
		Enable Chip Interface.
config BCMDHD_100_10_545_X_SDIO
		bool "SDIO bus interface support"
		depends on BCMDHD_100_10_545_X && MMC
config BCMDHD_100_10_545_X_PCIE
		bool "PCIe bus interface support"
		depends on BCMDHD_100_10_545_X && PCI
config BCMDHD_100_10_545_X_USB
		bool "USB bus interface support"
		depends on BCMDHD_100_10_545_X && USB
endchoice

choice
	depends on BCMDHD_100_10_545_X && BCMDHD_100_10_545_X_SDIO
	prompt "Interrupt type"
	---help---
		Interrupt type
config BCMDHD_100_10_545_X_OOB
	depends on BCMDHD_100_10_545_X && BCMDHD_100_10_545_X_SDIO
	bool "Out-of-Band Interrupt"
	---help---
		Interrupt from WL_HOST_WAKE.
config BCMDHD_100_10_545_X_SDIO_IRQ
	depends on BCMDHD_100_10_545_X && BCMDHD_100_10_545_X_SDIO
	bool "In-Band Interrupt"
	---help---
	  Interrupt from SDIO DAT[1]
endchoice
```

## opensource/kernel-4.4.94/drivers/net/wireless/bcmdhd_1_363_59_144/Kconfig
```kconfig
config BCMDHD_1_363_59_144
	tristate "Broadcom FullMAC wireless cards support"
	---help---
	  This module adds support for wireless adapters based on
	  Broadcom FullMAC chipset.

config BCMDHD_1_363_59_144_FW_PATH
	depends on BCMDHD_1_363_59_144
	string "Firmware path"
	default "/firmware/fw_bcm43438.bin"
	---help---
	  Path to the firmware file.

config BCMDHD_1_363_59_144_NVRAM_PATH
	depends on BCMDHD_1_363_59_144
	string "NVRAM path"
	default "/firmware/bcm43438.cal"
	---help---
	  Path to the calibration file.

config BCMDHD_1_363_59_144_WEXT
	bool "Enable WEXT support"
	depends on BCMDHD_1_363_59_144 && CFG80211 = n
	select WIRELESS_EXT
	select WEXT_PRIV
	help
	  Enables WEXT support

choice
	prompt "Enable Chip Interface"
	depends on BCMDHD_1_363_59_144
	---help---
		Enable Chip Interface.
config BCMDHD_1_363_59_144_SDIO
		bool "SDIO bus interface support"
		depends on BCMDHD_1_363_59_144 && MMC
config BCMDHD_1_363_59_144_PCIE
		bool "PCIe bus interface support"
		depends on BCMDHD_1_363_59_144 && PCI
endchoice

choice
	depends on BCMDHD_1_363_59_144 && BCMDHD_1_363_59_144_SDIO
	prompt "Interrupt type"
	---help---
		Interrupt type
config BCMDHD_1_363_59_144_OOB
	depends on BCMDHD_1_363_59_144 && BCMDHD_1_363_59_144_SDIO
	bool "Out-of-Band Interrupt"
	---help---
		Interrupt from WL_HOST_WAKE.
config BCMDHD_1_363_59_144_SDIO_IRQ
	depends on BCMDHD_1_363_59_144 && BCMDHD_1_363_59_144_SDIO
	bool "In-Band Interrupt"
	---help---
	  Interrupt from SDIO DAT[1]
endchoice
```

## opensource/kernel-4.4.94/drivers/video/fbdev/ingenic/fb_v14/Kconfig
```kconfig
menuconfig FB_INGENIC_V14
	tristate "Ingenic Framebuffer Driver for Version 14"
	depends on FB_INGENIC
	select FB_INGENIC_DISPLAYS_V14
	help
	  Framebuffer support for the T41 SoC.

source "drivers/video/fbdev/ingenic/fb_v14/displays/Kconfig"
```

## opensource/kernel-4.4.94/drivers/video/fbdev/ingenic/fb_v14/displays/Kconfig
```kconfig
menuconfig FB_INGENIC_DISPLAYS_V14
	tristate "Supported lcd panels"
	depends on FB_INGENIC_V14

config PANEL_TRULY240320
  tristate "lcd panel truly240320"
  depends on FB_INGENIC_DISPLAYS_V14

config PANEL_ST7789
  tristate "lcd panel st7789"
  depends on FB_INGENIC_DISPLAYS_V14
```

## opensource/kernel-4.4.94/drivers/video/ingenic_vo/Kconfig
```kconfig
menuconfig JZ_VO
    bool "JZ VO Driver"
    default y
    help
        Support for Ingenic vo Driver

config INGENIC_VO
	bool "Ingenic VO Driver"
    depends on JZ_VO
    default y
	help
	  Support for Ingenic vo  operations.
```

## opensource/kernel-4.4.94/drivers/video/ingenic_vpu/Kconfig
```kconfig
#
# soc_vpu configuration
#
menuconfig SOC_VPU
    bool "soc vpu driver"
    default n
    help
        soc vpu platform dirver

if SOC_VPU
config CHANNEL_NODE_NUM
    int "channel node number"
    default 4

config VPU_NODE_NUM
    depends on SOC_VPU
    int "vpu node number"
    default 1

source "drivers/video/ingenic_vpu/helix/Kconfig"
source "drivers/video/ingenic_vpu/radix/Kconfig"

endif
```
