## opensource/kernel-3.10.14/arch/mips/xburst2/soc-t40/Kconfig
```kconfig
choice
	prompt "Chip type"
	depends on SOC_T40
	default CHIP_T40

config CHIP_T40
       bool "chip-t40"
       select TRACEPOINTS
       select SYS_SUPPORTS_HIGHMEM
       select GENERIC_CLOCKEVENTS_BROADCAST

endchoice

if CHIP_T40
source "arch/mips/xburst2/soc-t40/chip-t40/Kconfig"
endif
```

## opensource/kernel-3.10.14/arch/mips/xburst2/soc-t40/chip-t40/Kconfig
```kconfig
choice
	prompt "Platform type"
	depends on CHIP_T40
	default PLATFORM_T40_ISVP

config PLATFORM_T40_ISVP
	bool "isvp"

endchoice

config PRODUCT_NAME
	string
	default "isvp" if PLATFORM_T40_ISVP

if PLATFORM_T40_ISVP
source "arch/mips/xburst2/soc-t40/chip-t40/isvp/Kconfig"
endif
```

## opensource/kernel-3.10.14/arch/mips/xburst2/soc-t40/chip-t40/isvp/Kconfig
```kconfig
choice
	prompt "Board type"
	depends on PLATFORM_T40_ISVP
	default BOARD_SWAN

config BOARD_SWAN
       bool "Swan"
       depends on PLATFORM_T40_ISVP

endchoice

config BOARD_NAME
	string
	default "Swan" if BOARD_SWAN
```

## opensource/kernel-3.10.14/arch/mips/xburst2/soc-t41/Kconfig
```kconfig
choice
	prompt "Chip type"
	depends on SOC_T41
	default CHIP_T41

config CHIP_T41
       bool "chip-t41"
       # select TRACEPOINTS
       select SYS_SUPPORTS_HIGHMEM
       select GENERIC_CLOCKEVENTS_BROADCAST

endchoice

if CHIP_T41
source "arch/mips/xburst2/soc-t41/chip-t41/Kconfig"
endif

config KERNEL_3_10
    depends on SOC_T41
    bool "kernel3.10 version"
    default y
```

## opensource/kernel-3.10.14/arch/mips/xburst2/soc-t41/chip-t41/Kconfig
```kconfig
choice
	prompt "Platform type"
	depends on CHIP_T41
	default PLATFORM_T41_ISVP

config PLATFORM_T41_ISVP
	bool "isvp"

endchoice

config PRODUCT_NAME
	string
	default "isvp" if PLATFORM_T41_ISVP

if PLATFORM_T41_ISVP
source "arch/mips/xburst2/soc-t41/chip-t41/isvp/Kconfig"
endif
```

## opensource/kernel-3.10.14/arch/mips/xburst2/soc-t41/chip-t41/isvp/Kconfig
```kconfig
choice
	prompt "Board type"
	depends on PLATFORM_T41_ISVP
	default BOARD_MARMOT

config BOARD_MARMOT
       bool "Marmot"
       depends on PLATFORM_T41_ISVP

endchoice

config BOARD_NAME
	string
	default "Marmot" if BOARD_MARMOT
```

## opensource/kernel-3.10.14/drivers/mtd/devices/ingenic_sfc_v1/Kconfig
```kconfig
config INGENIC_SFC_V1
	tristate "Ingenic series SFC driver v1"
	depends on  MACH_XBURST2
	help
		SFC driver version v1.0 for Ingenic series SoCs

if INGENIC_SFC_V1

config INGENIC_SFC_V1_NOR
	tristate "Ingenic JZ SFC nor"
	depends on INGENIC_SFC_V1
	help
		SFC driver for Ingenic JZ sfc nor

config INGENIC_SFC_V1_NAND
	tristate "Ingenic JZ SFC nand"
	depends on INGENIC_SFC_V1
	help
		SFC driver for Ingenic JZ sfc nand

config SFC_DMA
	bool "used dma"
	depends on INGENIC_SFC_V1_NOR
	help
		used dma

config SFC_SPEED
    int "JZ SFC speed in MHZ"
	range 10 200
	default 50
	depends on INGENIC_SFC_V1
	help
	    Select sfc speed.
		Examples:
			50 =>  50 MHZ

choice
	prompt "sfc Mode"
	help
	  Select sfc Mode

config SPI_STARDARD
	bool "standard spi mode"
	depends on INGENIC_SFC_V1
	help
	  Say Y here to enable spi STANDARD MODE

config SPI_QUAD
	bool "quad spi mode"
	depends on INGENIC_SFC_V1
	help
	  Say Y Here to enable spi QUAD MODE
endchoice

endif
```

## opensource/kernel-3.10.14/drivers/mtd/devices/ingenic_sfc_v2/Kconfig
```kconfig
config INGENIC_SFC_V2
	tristate "Ingenic series SFC driver v2"
	depends on MACH_XBURST2
	help
		SFC driver version v2.0 for Ingenic series SoCs

if INGENIC_SFC_V2

choice
	prompt "sfc Mode"
	help
	  Select sfc Mode

config SPI_STANDARD_MODE
	bool "standard spi mode"
	depends on INGENIC_SFC_V2
	help
	  Say Y here to enable spi standard mode

config SPI_QUAD_MODE
	bool "quad spi mode"
	depends on INGENIC_SFC_V2
	help
	  Say Y Here to enable spi QUAD MODE
endchoice

config SFC0
	tristate "Ingenic series SFC0"
	depends on INGENIC_SFC_V2
	help
		Say Y here to enable sfc 0

if SFC0
config SFC0_SPEED
    int "ingenic SFC speed in MHZ"
	range 20 200
	default 100
	depends on SFC0
	help
	    Select sfc speed.
		Examples:
			100 =>  50 MHZ
choice
	prompt "the SFC0 external memory (nor or nand)"
	help
	  Select the SFC external memory

config SFC0_V2_NORFLASH
	bool "nor"
	depends on SFC0
	select MTD_INGENIC_SFC_V2_NORFLASH

config SFC0_V2_NANDFLASH
	bool "nand"
	depends on SFC0
	select MTD_INGENIC_SFC_V2_NANDFLASH

endchoice

endif

config SFC1
	tristate "Ingenic series SFC1"
	depends on INGENIC_SFC_V2
	help
		Say Y here to enable sfc 1

if SFC1
config SFC1_SPEED
    int "ingenic SFC speed in MHZ"
	range 20 200
	default 100
	depends on SFC1
	help
	    Select sfc speed.
		Examples:
			100 =>  50 MHZ
choice
	prompt "the SFC1 external memory (nor or nand)"
	help
	  Select the SFC external memory

config SFC1_V2_NORFLASH
	bool "nor"
	depends on SFC1
	select MTD_INGENIC_SFC_V2_NORFLASH

config SFC1_V2_NANDFLASH
	bool "nand"
	depends on SFC1
	select MTD_INGENIC_SFC_V2_NANDFLASH

endchoice

endif



config MTD_INGENIC_SFC_V2_NORFLASH
	bool "Support ingenic sfc-nor"
	depends on INGENIC_SFC_V2

if MTD_INGENIC_SFC_V2_NORFLASH

choice
	prompt "Erase block size"
	help
	Select nor flash erase block size

config ERASE_SIZE_32K
	bool "sfc-nor 32k erase block"
	depends on MTD_INGENIC_SFC_V2_NORFLASH

config ERASE_SIZE_64K
	bool "sfc-nor 64k erase block"
	depends on MTD_INGENIC_SFC_V2_NORFLASH

endchoice

config JZ_SFC_NOR_RESET
	bool "Reset nor flash in the kernel"
	depends on MTD_INGENIC_SFC_V2_NORFLASH
	help
		Reset nor flash in the kernel
endif

config MTD_INGENIC_SFC_V2_NANDFLASH
	bool "Support ingenic sfc-nand"
	depends on INGENIC_SFC_V2
	select MTD_NAND


endif
```

## opensource/kernel-3.10.14/drivers/pwm/Kconfig
```kconfig
menuconfig PWM
	bool "Pulse-Width Modulation (PWM) Support"
	help
	  Generic Pulse-Width Modulation (PWM) support.

	  In Pulse-Width Modulation, a variation of the width of pulses
	  in a rectangular pulse signal is used as a means to alter the
	  average power of the signal. Applications include efficient
	  power delivery and voltage regulation. In computer systems,
	  PWMs are commonly used to control fans or the brightness of
	  display backlights.

	  This framework provides a generic interface to PWM devices
	  within the Linux kernel. On the driver side it provides an API
	  to register and unregister a PWM chip, an abstraction of a PWM
	  controller, that supports one or more PWM devices. Client
	  drivers can request PWM devices and use the generic framework
	  to configure as well as enable and disable them.

	  This generic framework replaces the legacy PWM framework which
	  allows only a single driver implementing the required API. Not
	  all legacy implementations have been ported to the framework
	  yet. The framework provides an API that is backward compatible
	  with the legacy framework so that existing client drivers
	  continue to work as expected.

	  If unsure, say no.

if PWM

config PWM_SYSFS
	bool
	default y if SYSFS

config PWM_AB8500
	tristate "AB8500 PWM support"
	depends on AB8500_CORE && ARCH_U8500
	help
	  Generic PWM framework driver for Analog Baseband AB8500.

	  To compile this driver as a module, choose M here: the module
	  will be called pwm-ab8500.

config PWM_ATMEL_TCB
	tristate "Atmel TC Block PWM support"
	depends on ATMEL_TCLIB && OF
	help
	  Generic PWM framework driver for Atmel Timer Counter Block.

	  A Timer Counter Block provides 6 PWM devices grouped by 2.
	  Devices in a given group must have the same period.

	  To compile this driver as a module, choose M here: the module
	  will be called pwm-atmel-tcb.

config PWM_BFIN
	tristate "Blackfin PWM support"
	depends on BFIN_GPTIMERS
	help
	  Generic PWM framework driver for Blackfin.

	  To compile this driver as a module, choose M here: the module
	  will be called pwm-bfin.

config PWM_IMX
	tristate "i.MX PWM support"
	depends on ARCH_MXC
	help
	  Generic PWM framework driver for i.MX.

	  To compile this driver as a module, choose M here: the module
	  will be called pwm-imx.

config PWM_JZ4740
	tristate "Ingenic JZ4740 PWM support"
	depends on MACH_JZ4740
	help
	  Generic PWM framework driver for Ingenic JZ4740 based
	  machines.

	  To compile this driver as a module, choose M here: the module
	  will be called pwm-jz4740.

config PWM_LPC32XX
	tristate "LPC32XX PWM support"
	depends on ARCH_LPC32XX
	help
	  Generic PWM framework driver for LPC32XX. The LPC32XX SOC has two
	  PWM controllers.

	  To compile this driver as a module, choose M here: the module
	  will be called pwm-lpc32xx.

config PWM_MXS
	tristate "Freescale MXS PWM support"
	depends on ARCH_MXS && OF
	select STMP_DEVICE
	help
	  Generic PWM framework driver for Freescale MXS.

	  To compile this driver as a module, choose M here: the module
	  will be called pwm-mxs.

config PWM_PUV3
	tristate "PKUnity NetBook-0916 PWM support"
	depends on ARCH_PUV3
	help
	  Generic PWM framework driver for PKUnity NetBook-0916.

	  To compile this driver as a module, choose M here: the module
	  will be called pwm-puv3.

config PWM_PXA
	tristate "PXA PWM support"
	depends on ARCH_PXA
	help
	  Generic PWM framework driver for PXA.

	  To compile this driver as a module, choose M here: the module
	  will be called pwm-pxa.

config PWM_SAMSUNG
	tristate "Samsung PWM support"
	depends on PLAT_SAMSUNG
	help
	  Generic PWM framework driver for Samsung.

	  To compile this driver as a module, choose M here: the module
	  will be called pwm-samsung.

config PWM_SPEAR
	tristate "STMicroelectronics SPEAr PWM support"
	depends on PLAT_SPEAR
	depends on OF
	help
	  Generic PWM framework driver for the PWM controller on ST
	  SPEAr SoCs.

	  To compile this driver as a module, choose M here: the module
	  will be called pwm-spear.

config PWM_TEGRA
	tristate "NVIDIA Tegra PWM support"
	depends on ARCH_TEGRA
	help
	  Generic PWM framework driver for the PWFM controller found on NVIDIA
	  Tegra SoCs.

	  To compile this driver as a module, choose M here: the module
	  will be called pwm-tegra.

config  PWM_TIECAP
	tristate "ECAP PWM support"
	depends on SOC_AM33XX || ARCH_DAVINCI_DA8XX
	help
	  PWM driver support for the ECAP APWM controller found on AM33XX
	  TI SOC

	  To compile this driver as a module, choose M here: the module
	  will be called pwm-tiecap.

config  PWM_TIEHRPWM
	tristate "EHRPWM PWM support"
	depends on SOC_AM33XX || ARCH_DAVINCI_DA8XX
	help
	  PWM driver support for the EHRPWM controller found on AM33XX
	  TI SOC

	  To compile this driver as a module, choose M here: the module
	  will be called pwm-tiehrpwm.

config  PWM_TIPWMSS
	bool
	default y if SOC_AM33XX && (PWM_TIECAP || PWM_TIEHRPWM)
	help
	  PWM Subsystem driver support for AM33xx SOC.

	  PWM submodules require PWM config space access from submodule
	  drivers and require common parent driver support.

config PWM_TWL
	tristate "TWL4030/6030 PWM support"
	depends on TWL4030_CORE
	help
	  Generic PWM framework driver for TWL4030/6030.

	  To compile this driver as a module, choose M here: the module
	  will be called pwm-twl.

config PWM_TWL_LED
	tristate "TWL4030/6030 PWM support for LED drivers"
	depends on TWL4030_CORE
	help
	  Generic PWM framework driver for TWL4030/6030 LED terminals.

	  To compile this driver as a module, choose M here: the module
	  will be called pwm-twl-led.

config PWM_VT8500
	tristate "vt8500 PWM support"
	depends on ARCH_VT8500
	help
	  Generic PWM framework driver for vt8500.

	  To compile this driver as a module, choose M here: the module
	  will be called pwm-vt8500.

config PWM_INGENIC
	tristate "Ingenic PWM support"
	depends on MACH_XBURST2
	help
	  Generic PWM framework driver for Ingenic soc based
	  machines.

	  To compile this driver as a module, choose M here: the module
	  will be called pwm-ingenic.

config PWM_CHANNEL0_ENABLE
	depends on PWM_INGENIC
	bool "PWM channel0 Enable"
choice
	depends on PWM_CHANNEL0_ENABLE
	prompt "PWM channel0 GPIO select"
	default PWM_CHANNEL0_PC15
config PWM_CHANNEL0_PB17
	bool "PWM channel0 PB17"
config PWM_CHANNEL0_PC15
	bool "PWM channel0 PC15"
endchoice

config PWM_CHANNEL1_ENABLE
	depends on PWM_INGENIC
	bool "PWM channel1 Enable"
choice
	depends on PWM_CHANNEL1_ENABLE
	prompt "PWM channel1 GPIO select"
	default PWM_CHANNEL1_PC16
config PWM_CHANNEL1_PB18
	bool "PWM channel1 PB18"
config PWM_CHANNEL1_PC16
	bool "PWM channel1 PC16"
endchoice

config PWM_CHANNEL2_ENABLE
	depends on PWM_INGENIC
	bool "PWM channel2 Enable"
choice
	depends on PWM_CHANNEL2_ENABLE
	prompt "PWM channel2 GPIO select"
	default PWM_CHANNEL2_PC17
config PWM_CHANNEL2_PB08
	bool "PWM channel2 PB08"
config PWM_CHANNEL2_PC17
	bool "PWM channel2 PC17"
endchoice

config PWM_CHANNEL3_ENABLE
	depends on PWM_INGENIC
	bool "PWM channel3 Enable"
choice
	depends on PWM_CHANNEL3_ENABLE
	prompt "PWM channel3 GPIO select"
	default PWM_CHANNEL3_PC18
config PWM_CHANNEL3_PB09
	bool "PWM channel3 PB09"
config PWM_CHANNEL3_PC18
	bool "PWM channel3 PC18"
endchoice

config PWM_CHANNEL4_ENABLE
	depends on PWM_INGENIC
	bool "PWM channel4 Enable"
choice
	depends on PWM_CHANNEL4_ENABLE
	prompt "PWM channel4 GPIO select"
	default PWM_CHANNEL4_PD09
config PWM_CHANNEL4_PB13
	bool "PWM channel4 PB13"
config PWM_CHANNEL4_PD09
	bool "PWM channel4 PD09"
endchoice

config PWM_CHANNEL5_ENABLE
	depends on PWM_INGENIC
	bool "PWM channel5 Enable"
choice
	depends on PWM_CHANNEL5_ENABLE
	prompt "PWM channel5 GPIO select"
	default PWM_CHANNEL5_PD10
config PWM_CHANNEL5_PB14
	bool "PWM channel5 PB14"
config PWM_CHANNEL5_PD10
	bool "PWM channel5 PD10"
endchoice

config PWM_CHANNEL6_ENABLE
	depends on PWM_INGENIC
	bool "PWM channel6 Enable"
choice
	depends on PWM_CHANNEL6_ENABLE
	prompt "PWM channel6 GPIO select"
	default PWM_CHANNEL6_PD11
config PWM_CHANNEL6_PB15
	bool "PWM channel6 PB15"
config PWM_CHANNEL6_PD11
	bool "PWM channel6 PD11"
endchoice

config PWM_CHANNEL7_ENABLE
	depends on PWM_INGENIC
	bool "PWM channel7 Enable"
choice
	depends on PWM_CHANNEL7_ENABLE
	prompt "PWM channel7 GPIO select"
	default PWM_CHANNEL7_PD12
config PWM_CHANNEL7_PB16
	bool "PWM channel7 PB16"
config PWM_CHANNEL7_PD12
	bool "PWM channel7 PD12"
endchoice

endif
```

## opensource/kernel-3.10.14/drivers/video/jz_fb_v14/Kconfig
```kconfig
menuconfig FB_JZ_V14
	tristate "JZ LCDC framebuffer V1.4"
	depends on FB
	select FB_JZ_DISPLAYS_V14
	help  
	  Framebuffer support for the T41 SoC.

source "drivers/video/jz_fb_v14/displays/Kconfig"
```

## opensource/kernel-3.10.14/drivers/video/jz_fb_v14/displays/Kconfig
```kconfig
menuconfig FB_JZ_DISPLAYS_V14
	tristate "Supported lcd panels"
	depends on FB_JZ_V14

config PANEL_TRULY240320
  tristate "lcd panel truly240320"
  depends on FB_JZ_DISPLAYS_V14

config PANEL_ST7789
  tristate "lcd panel st7789"
  depends on FB_JZ_DISPLAYS_V14
```

## opensource/kernel-3.10.14/drivers/video/jz_fb_v15/Kconfig
```kconfig
menuconfig FB_JZ_V15
	tristate "JZ LCDC framebuffer V1.5"
	depends on FB
	select FB_CFB_FILLRECT
	select FB_CFB_COPYAREA
	select FB_CFB_IMAGEBLIT
	help
	  Framebuffer support for the X2000 DPU SoC.

config DPU_GPIO_DRIVE_STRENGTH
        int "Dpu gpio drive strength[0..7]"
        depends on SOC_X2000_V12 && FB_JZ_V15 && !JZ_MIPI_DSI
        default 5
        help
		Dpu gpio drive strength
```

## opensource/kernel-3.10.14/drivers/video/jz_fb_v16/Kconfig
```kconfig
menuconfig FB_JZ_V16
	tristate "JZ LCDC framebuffer V1.6"
	depends on FB
	select FB_CFB_FILLRECT
	select FB_CFB_COPYAREA
	select FB_CFB_IMAGEBLIT
	help
	  Framebuffer support for the X2000 SoC.

choice
	prompt "SLCD or TFT"
	depends on FB_JZ_V16

	config SLCD
		bool "SLCD"

	config TFT
		bool "TFT"
endchoice

config MIPI_TX
	tristate "MIPI_TX"
	depends on FB_JZ_V16
choice
	prompt "2 LANE or 4 LANE"
	depends on MIPI_TX

	config MIPI_2LANE
		bool "2LANE"

	config MIPI_4LANE
		bool "4LANE"
endchoice
```
